## firmware/main/Kconfig.projbuild
```kconfig
menu "ZE2 spoof board"
    config ZE2_SIM
        bool "Simulation build (virtual CAN buses for QEMU load testing)"
        default n
    config ZE2_SIM_SECONDS
        int "Seconds per simulated scenario"
        depends on ZE2_SIM
        default 6
    config ZE2_WIFI_AP_SSID
        string "Wi-Fi access point SSID"
        default "ZE2-SPOOF"
    config ZE2_WIFI_AP_PASS
        string "Wi-Fi access point password (8+ chars)"
        default "change-me-please"
endmenu
```

## firmware/sdkconfig.defaults
```kconfig
CONFIG_IDF_TARGET="esp32s3"
CONFIG_ESPTOOLPY_FLASHSIZE_8MB=y
CONFIG_PARTITION_TABLE_CUSTOM=y
CONFIG_PARTITION_TABLE_CUSTOM_FILENAME="partitions.csv"
CONFIG_ESP_DEFAULT_CPU_FREQ_MHZ_240=y
CONFIG_FREERTOS_HZ=1000
CONFIG_FREERTOS_GENERATE_RUN_TIME_STATS=y
CONFIG_FREERTOS_USE_TRACE_FACILITY=y
CONFIG_BOOTLOADER_APP_ROLLBACK_ENABLE=y
CONFIG_COMPILER_OPTIMIZATION_PERF=y
CONFIG_ESP_TIMER_SUPPORTS_ISR_DISPATCH_METHOD=y
CONFIG_SPI_MASTER_IN_IRAM=y
CONFIG_SPI_MASTER_ISR_IN_IRAM=y
CONFIG_ESP_TASK_WDT_TIMEOUT_S=2
CONFIG_ESP_TASK_WDT_PANIC=y
CONFIG_ESP_MAIN_TASK_STACK_SIZE=6144
CONFIG_HTTPD_MAX_REQ_HDR_LEN=1024
CONFIG_LWIP_MAX_SOCKETS=8
```
